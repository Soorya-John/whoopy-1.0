## firmware/drone_esp32c3/main/Kconfig.projbuild
```kconfig
menu "Whoopy drone settings"
config WHOOPY_AP_SSID
    string "Configuration AP SSID"
    default "whoopy"
config WHOOPY_AP_PASSWORD
    string "Configuration AP password (8+ chars)"
    default "whoopy-setup-2026"
endmenu
```

## firmware/drone_esp32c3/sdkconfig.defaults
```kconfig
CONFIG_IDF_TARGET="esp32c3"
CONFIG_WHOOPY_AP_SSID="whoopy"
CONFIG_COMPILER_OPTIMIZATION_PERF=y
CONFIG_FREERTOS_HZ=1000
CONFIG_ESP_MAIN_TASK_STACK_SIZE=6144
CONFIG_ESP_CONSOLE_USB_SERIAL_JTAG=y
```

## firmware/transmitter_esp32s3/main/Kconfig.projbuild
```kconfig
menu "Whoopy transmitter settings"
config WHOOPY_ARM_BUTTON_BIT
 int "Arm switch bit index in HID report (provisional)"
 range 0 127
 default 64
config WHOOPY_ARM_ACTIVE_HIGH
 bool "Arm switch active high"
 default y
config WHOOPY_HID_AXIS0_BIT
 int "Roll field starting bit offset (after report ID)"
 range 0 512
 default 0
config WHOOPY_HID_AXIS1_BIT
 int "Pitch field starting bit offset"
 range 0 512
 default 16
config WHOOPY_HID_AXIS2_BIT
 int "Yaw field starting bit offset"
 range 0 512
 default 32
config WHOOPY_HID_AXIS3_BIT
 int "Throttle field starting bit offset"
 range 0 512
 default 48
config WHOOPY_HID_AXIS_WIDTH
 int "Axis bit width"
 range 1 16
 default 16
config WHOOPY_HID_REPORT_ID_PRESENT
 bool "First byte in input report is a report ID"
 default y
config WHOOPY_HID_ROLL_INVERT
 bool "Invert roll axis"
 default n
config WHOOPY_HID_PITCH_INVERT
 bool "Invert pitch axis"
 default y
config WHOOPY_HID_YAW_INVERT
 bool "Invert yaw axis"
 default n
config WHOOPY_HID_THROTTLE_INVERT
 bool "Invert throttle axis"
 default y
config WHOOPY_HID_AXIS_MIN
 int "Axis raw minimum"
 default 0
config WHOOPY_HID_AXIS_MAX
 int "Axis raw maximum"
 default 65535
config WHOOPY_HID_DEADZONE
 int "Centered axis deadzone (permille)"
 range 0 200
 default 30
endmenu
```

## firmware/transmitter_esp32s3/sdkconfig.defaults
```kconfig
CONFIG_IDF_TARGET="esp32s3"
CONFIG_COMPILER_OPTIMIZATION_PERF=y
CONFIG_FREERTOS_HZ=1000
```
